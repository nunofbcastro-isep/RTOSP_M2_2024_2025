## linux-5.19.9-moker/kernel/moker/Kconfig
```kconfig
menu "MOKER framework"

config MOKER_FRAMEWORK
bool "My Own KERnel Framework"
default y

config MOKER_TRACING
bool "MOKER tracing"
default y
depends on MOKER_FRAMEWORK

config MOKER_SCHED_LIFO_POLICY
bool "MOKER scheduling policy: LIFO"
default y
depends on MOKER_FRAMEWORK

config MOKER_MUTEX_LIFO
bool "MOKER mutex policy: LIFO"
default y
depends on MOKER_FRAMEWORK

config MOKER_SCHED_RM_POLICY
bool "MOKER scheduling policy: RM"
default y
depends on MOKER_FRAMEWORK

config MOKER_MUTEX_PIP
bool "MOKER mutex policy: PIP"
default y
depends on MOKER_FRAMEWORK

config MOKER_MUTEX_PCP
bool "MOKER mutex policy: PCP"
default y
depends on MOKER_FRAMEWORK

endmenu
```
